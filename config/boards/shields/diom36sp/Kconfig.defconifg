## config/boards/shields/diom36sp/Kconfig.defconifg
```kconfig
if SHIELD_DIOM36SP_LEFT

config ZMK_KEYBOARD_NAME
	default "Diom-36SP"
	
config ZMK_SPLIT_ROLE_CENTRAL
	default y
	
endif

if SHIELD_DIOM36SP_LEFT || SHIELD_DIOM36SP_RIGHT

conifg ZMK_SPLIT
	default y
	
endif
```

## config/boards/shields/diom36sp_PB/Kconfig.shield
```kconfig
config SHIELD_DIOM36SP_LEFT
	def_bool $(shields_list_contains,diom36sp_left)
	
config SHIELD_DIOM36SP_RIGHT
	def_bool $(shields_list_contains,diom36sp_right)
```

## config/west.yml
```yaml
manifest:
  remotes:
    - name: zmkfirmware
      url-base: https://github.com/zmkfirmware
    - name: diomkbs
      url-base: https://github.com/DiomKBS
  projects:
    - name: zmk
      remote: diomkbs
      revision: main
      import: app/west.yml
  self:
    path: config
```
